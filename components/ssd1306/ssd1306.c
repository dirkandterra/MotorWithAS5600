#include "ssd1306.h"
#include "esp_log.h"
#include <string.h>
#include <stdio.h>

#define TAG "SSD1306"

/* 5x7 font, ASCII 32–126 */
static const uint8_t font5x7[][5] = {
    {0x00,0x00,0x00,0x00,0x00}, // ' '
    {0x00,0x00,0x5F,0x00,0x00}, // '!'
    {0x00,0x07,0x00,0x07,0x00}, // '"'
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    {0x10,0x08,0x08,0x10,0x08}, // '~'
};

static esp_err_t ssd1306_cmd(ssd1306_t *dev, uint8_t cmd)
{
    uint8_t buf[2] = {0x00, cmd};
    return i2c_master_transmit(dev->dev_handle, buf, 2, 100);
}

esp_err_t ssd1306_init(i2c_master_bus_handle_t bus, uint8_t addr, ssd1306_t *dev)
{
    i2c_device_config_t cfg = {
        .dev_addr_length = I2C_ADDR_BIT_LEN_7,
        .device_address  = addr,
        .scl_speed_hz    = 400000,
    };
    esp_err_t ret = i2c_master_bus_add_device(bus, &cfg, &dev->dev_handle);
    if (ret != ESP_OK) return ret;

    static const uint8_t init_cmds[] = {
        0xAE,       // display off
        0xD5, 0x80, // clock divide / osc freq
        0xA8, 0x3F, // multiplex ratio (64-1)
        0xD3, 0x00, // display offset
        0x40,       // start line 0
        0x8D, 0x14, // charge pump enable
        0x20, 0x00, // horizontal addressing
        0xA1,       // seg remap
        0xC8,       // com scan dec
        0xDA, 0x12, // com pins
        0x81, 0xCF, // contrast
        0xD9, 0xF1, // pre-charge
        0xDB, 0x40, // vcomh deselect
        0xA4,       // resume RAM content
        0xA6,       // normal display
        0xAF,       // display on
    };
    for (size_t i = 0; i < sizeof(init_cmds); i++) {
        ret = ssd1306_cmd(dev, init_cmds[i]);
        if (ret != ESP_OK) return ret;
    }
    ssd1306_clear(dev);
    return ssd1306_flush(dev);
}

void ssd1306_clear(ssd1306_t *dev)
{
    memset(dev->buf, 0, sizeof(dev->buf));
}

esp_err_t ssd1306_flush(ssd1306_t *dev)
{
    ssd1306_cmd(dev, 0x21); ssd1306_cmd(dev, 0); ssd1306_cmd(dev, 127);
    ssd1306_cmd(dev, 0x22); ssd1306_cmd(dev, 0); ssd1306_cmd(dev, 7);

    /* Send framebuffer in one transfer: 1 control byte + 1024 data bytes */
    uint8_t tx[1 + sizeof(dev->buf)];
    tx[0] = 0x40;
    memcpy(tx + 1, dev->buf, sizeof(dev->buf));
    return i2c_master_transmit(dev->dev_handle, tx, sizeof(tx), 200);
}

void ssd1306_draw_char(ssd1306_t *dev, uint8_t col, uint8_t row, char c)
{
    if (c < 32 || c > 126) c = ' ';
    const uint8_t *glyph = font5x7[c - 32];
    uint16_t base = row * SSD1306_WIDTH + col;
    for (int i = 0; i < 5 && (col + i) < SSD1306_WIDTH; i++) {
        dev->buf[base + i] = glyph[i];
    }
    if (col + 5 < SSD1306_WIDTH) dev->buf[base + 5] = 0x00;
}

void ssd1306_draw_string(ssd1306_t *dev, uint8_t col, uint8_t row, const char *str)
{
    while (*str && col < SSD1306_WIDTH) {
        ssd1306_draw_char(dev, col, row, *str++);
        col += 6;
    }
}
